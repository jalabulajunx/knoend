## firmware/components/board_api/Kconfig
```kconfig
menu "OpenPager board"

    choice OPENPAGER_BOARD
        prompt "Board profile"
        default OPENPAGER_BOARD_ONX2432G028
        help
            Normally set from boards/sdkconfig.defaults.<board> via -DOPENPAGER_BOARD.

        config OPENPAGER_BOARD_ONX2432G028
            bool "ONX2432G028 (Nextion Open G-series, 2.8\" ST7789 + CST826)"
        config OPENPAGER_BOARD_FNK0104B
            bool "Freenove FNK0104B (2.8\" ILI9341 + FT6336)"
    endchoice

endmenu
```
